//{ ============================================
//  Software Name :   ML_DETECTOR
//  ============================================ }
//{ ******************************************** }
//{ Written By WalWalWalides                     }
//{ CopyRight © 2019                             }
//{ Email : WalWalWalides@gmail.com              }
//{ GitHub :https://github.com/walwalwalides     }
//{ ******************************************** }
//#include <PCM.h>
#include <EEPROM.h>
#define LAMP_PIR  12 // LDR LAMP
#define LAMP_LDR  13 // LDR PhotoResistor
#define PIR 9   // choose the input pin (for PIR sensor) passive infrared sensor
int ldrPin = A0;
int valeur_Delay = 0;
int valeur_Black = 500;
String inputString = "";   
String outputString = ""; // a String to hold incoming data
bool stringComplete = false;  // whether the string is complete
bool runningPIR = false;
bool runningLDR = false;
int adresse1=103;
int adresse2=206;


int adresse3=412;
int adresse4=824;
//const unsigned char sample[] PROGMEM = {
//131, 125, 115, 152, 136, 115, 155, 141, 111, 118, 109, 162, 167,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 95,}; 
void setup()     
{  
//  startPlayback(sample, sizeof(sample));                                                 
Serial.begin(9600);
pinMode(LAMP_PIR, OUTPUT); 
pinMode(LAMP_LDR, OUTPUT);
pinMode(PIR,INPUT); // declare sensor as input       
pinMode(ldrPin, INPUT);     
  int valD = eepromReadInt(adresse1);
  if(valD >= 0){
    valeur_Delay = valD;
    Serial.println("PIR : "+String(valD)); 
  }   
  else if (valD >0)
  {  
  }

  int valB = eepromReadInt(adresse2);
  if(valB >= 0){
    valeur_Black = valB;
    Serial.println("LDR : "+String(valB)); 
  }   
  else if (valB <0)
  {  
   valeur_Black = 1000; //standard Value
  }

  int valB_ = eepromReadInt(adresse3);
  if(valB_ = 1){
  runningLDR = true;
    Serial.println("LDR START"); 
       ON_Func1();
  }   
  else 
  { 
   runningLDR = false;
  Serial.println("LDR STOP");    
  }
  int valD_ = eepromReadInt(adresse3);
  if(valD_ = 1){
  runningPIR = true;
    Serial.println("PIR START"); 
      ON_Func2(); 
  }   
  else 
  { 
   runningPIR = false;
  Serial.println("PIR STOP");    
  }



 firstSection(); 

}                                                                                                             
  void loop() {
  
    if (stringComplete)
    {
 //   Serial.println(inputString);
    // clear the string:


    
    int lastOpeningDelay = inputString.lastIndexOf('D');
    if (lastOpeningDelay > 0) 
    {
    inputString.remove(inputString.length() - 2,2);  
    int lastOpeningDelay = inputString.lastIndexOf('_');
    if (lastOpeningDelay > 0) 
    {
    inputString.remove(inputString.length() - 1,1);  
    int lastOpeningDelay = inputString.lastIndexOf('N');
    if (lastOpeningDelay > 0) 
    {
      
     runningPIR = true;
          Serial.println("PIR START"); 
       eepromWriteInt(adresse4,1);
        ON_Func2();
     } 
    
    else 
    
    {
     runningPIR = false;
     Serial.println("PIR STOP"); 
    eepromWriteInt(adresse4,0);
  }
    }
    else
    {
    valeur_Delay = inputString.toInt();  
    eepromWriteInt(adresse1,valeur_Delay);
    Serial.println("PIR : "+inputString);
    }
    
  
    }

    int lastOpeningBlack = inputString.lastIndexOf('B');
    if (lastOpeningBlack > 0) 
    {
    inputString.remove(inputString.length() - 2,2);
     int lastOpeningBlack = inputString.lastIndexOf('-');
    if (lastOpeningBlack > 0) 
    {
      inputString.remove(inputString.length() - 1,1);  
       int lastOpeningBlack = inputString.lastIndexOf('N');
       
      if (lastOpeningBlack > 0) 
    {
      
     runningLDR = true;
     Serial.println("LDR START"); 
     eepromWriteInt(adresse3,1);
     ON_Func1();
     
     } 
    else{
    runningLDR = false;
      Serial.println("LDR STOP");
       eepromWriteInt(adresse3,0);
     }
 
     
    }
    else
    {
     valeur_Black = inputString.toInt();
     eepromWriteInt(adresse2,valeur_Black);
    Serial.println("LDR : "+inputString);
    }
      
   
        
    }
    inputString = "";
    stringComplete = false;
    }
     
int valeur_ldr = analogRead(ldrPin); // read LDR value
int valeur_pir = digitalRead(PIR); // read input value
//  Serial.println(valeur_ldr);
// Serial.println(valeur_pir);
  
 if((valeur_ldr>valeur_Black) || ( valeur_pir==HIGH) ){

  if((valeur_ldr>valeur_Black)&&(runningLDR))
  {
      digitalWrite(LAMP_LDR,1);  // Turn ON the light

  
  }

 if (( valeur_pir==HIGH)&&(runningPIR)) {

      digitalWrite(LAMP_PIR,1);  // Turn ON the light
      
      delay(valeur_Delay);
     
     
 }
}
else {
  
       digitalWrite(LAMP_PIR,0); // Turn OFF the light
       digitalWrite(LAMP_LDR,0); // Turn OFF the light
       
}


 }
